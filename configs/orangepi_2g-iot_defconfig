## configs/orangepi_2g-iot_defconfig
```kconfig
BR2_arm=y
BR2_cortex_a5=y
BR2_ARM_ENABLE_NEON=y
BR2_ARM_INSTRUCTIONS_THUMB2=y
BR2_PACKAGE_HOST_LINUX_HEADERS_CUSTOM_3_10=y
BR2_TOOLCHAIN_HEADERS_AT_LEAST_3_10=y
BR2_TARGET_GENERIC_HOSTNAME="OrangePi_2G-IOT"
BR2_TARGET_GENERIC_ISSUE="Welcome to Buildroot for the Orange Pi 2G-IOT"
BR2_ROOTFS_POST_BUILD_SCRIPT="board/orangepi/orangepi-2g-iot/post-build.sh"
BR2_ROOTFS_POST_IMAGE_SCRIPT="board/orangepi/orangepi-2g-iot/post-image.sh"
BR2_LINUX_KERNEL=y
BR2_LINUX_KERNEL_CUSTOM_GIT=y
BR2_LINUX_KERNEL_CUSTOM_REPO_URL="https://github.com/orangepi-xunlong/OrangePiRDA_kernel.git"
BR2_LINUX_KERNEL_CUSTOM_REPO_VERSION="a72709c318b76fd285f27dfe9ef018bc15e16fbd"
BR2_LINUX_KERNEL_USE_CUSTOM_CONFIG=y
BR2_LINUX_KERNEL_CUSTOM_CONFIG_FILE="board/orangepi/orangepi-2g-iot/linux.config"
BR2_LINUX_KERNEL_PATCH="board/orangepi/orangepi-2g-iot/patches/linux"
BR2_TARGET_ROOTFS_EXT2=y
BR2_TARGET_ROOTFS_EXT2_4=y
# BR2_TARGET_ROOTFS_TAR is not set
BR2_TARGET_UBOOT=y
BR2_TARGET_UBOOT_BUILD_SYSTEM_LEGACY=y
BR2_TARGET_UBOOT_CUSTOM_GIT=y
BR2_TARGET_UBOOT_CUSTOM_REPO_URL="https://github.com/orangepi-xunlong/OrangePiRDA_uboot.git"
BR2_TARGET_UBOOT_CUSTOM_REPO_VERSION="5ee06c1afb7cf1b01c47117b823744e58af1ea74"
BR2_TARGET_UBOOT_PATCH="board/orangepi/orangepi-2g-iot/patches/u-boot"
BR2_TARGET_UBOOT_BOARDNAME="rda8810"
BR2_TARGET_UBOOT_FORMAT_CUSTOM=y
BR2_TARGET_UBOOT_FORMAT_CUSTOM_NAME="u-boot.rda"
BR2_PACKAGE_HOST_DOSFSTOOLS=y
BR2_PACKAGE_HOST_GENIMAGE=y
BR2_PACKAGE_HOST_MTOOLS=y
BR2_PACKAGE_HOST_UBOOT_TOOLS=y

# wireless support
BR2_PACKAGE_IW=y
BR2_PACKAGE_WIRELESS_TOOLS=y
BR2_PACKAGE_WIRELESS_TOOLS_LIB=y
BR2_PACKAGE_WPA_SUPPLICANT=y
BR2_PACKAGE_WPA_SUPPLICANT_NL80211=y
BR2_PACKAGE_WPA_SUPPLICANT_CLI=y

# spi flash support
BR2_PACKAGE_MTD=y
```

## package/telegramm-bot/Config.in
```kconfig
config BR2_PACKAGE_TELEGRAMM_BOT
	bool "telegramm-bot"
	help
	  Telegramm bot lib
```
